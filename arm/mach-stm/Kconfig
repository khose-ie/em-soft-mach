## arm/mach-stm/Kconfig
```kconfig
choice
	prompt "CPU Series with STMicroelectronics"
	depends on CPU_MACH_ST

config CPU_SERIES_STM32F1XX
	bool "STM32F1XX"

config CPU_SERIES_STM32F4XX
	bool "STM32F4XX"

config CPU_SERIES_STM32F7XX
	bool "STM32F7XX"

config CPU_SERIES_STM32H5XX
	bool "STM32H5XX"

config CPU_SERIES_STM32H7XX
	bool "STM32H7XX"

endchoice

source "arch/arm/mach-stm/stm32f1xx/Kconfig"
source "arch/arm/mach-stm/stm32f4xx/Kconfig"
source "arch/arm/mach-stm/stm32f7xx/Kconfig"
source "arch/arm/mach-stm/stm32h5xx/Kconfig"
source "arch/arm/mach-stm/stm32h7xx/Kconfig"
```

## arm/mach-stm/stm32f1xx/Kconfig
```kconfig
choice
	prompt "CPU Model"
	depends on CPU_SERIES_STM32F1XX

config CPU_MODEL_STM32F100XB
	bool "STM32F100XB"

config CPU_MODEL_STM32F100XE
	bool "STM32F100XE"

config CPU_MODEL_STM32F101X6
	bool "STM32F101X6"

config CPU_MODEL_STM32F101XB
	bool "STM32F101XB"

config CPU_MODEL_STM32F101XE
	bool "STM32F101XE"

config CPU_MODEL_STM32F101XG
	bool "STM32F101XG"

config CPU_MODEL_STM32F102X6
	bool "STM32F102X6"

config CPU_MODEL_STM32F102XB
	bool "STM32F102XB"

config CPU_MODEL_STM32F103X6
	bool "STM32F103X6"

config CPU_MODEL_STM32F103XB
	bool "STM32F103XB"

config CPU_MODEL_STM32F103XE
	bool "STM32F103XE"

config CPU_MODEL_STM32F103XG
	bool "STM32F103XG"

config CPU_MODEL_STM32F105XC
	bool "STM32F105XC"

config CPU_MODEL_STM32F107XC
	bool "STM32F107XC"

endchoice

choice
	prompt "Platform models"
	depends on CPU_SERIES_STM32F1XX

source "arch/arm/mach-stm/stm32f1xx/kconfig-platform"

endchoice
```

## arm/mach-stm/stm32f4xx/Kconfig
```kconfig
choice
	prompt "CPU Model with STMicroelectronics"
	depends on CPU_SERIES_STM32F4XX

config CPU_MODEL_STM32F401XC
	bool "STM32F401XC"

config CPU_MODEL_STM32F401XE
	bool "STM32F401XE"

config CPU_MODEL_STM32F405XX
	bool "STM32F405XX"

config CPU_MODEL_STM32F407XX
	bool "STM32F407XX"

config CPU_MODEL_STM32F410CX
	bool "STM32F410CX"

config CPU_MODEL_STM32F410RX
	bool "STM32F410RX"

config CPU_MODEL_STM32F410TX
	bool "STM32F410TX"

config CPU_MODEL_STM32F411XE
	bool "STM32F411XE"

config CPU_MODEL_STM32F412CX
	bool "STM32F412CX"

config CPU_MODEL_STM32F412RX
	bool "STM32F412RX"

config CPU_MODEL_STM32F412VX
	bool "STM32F412VX"

config CPU_MODEL_STM32F412ZX
	bool "STM32F412ZX"

config CPU_MODEL_STM32F413XX
	bool "STM32F413XX"

config CPU_MODEL_STM32F415XX
	bool "STM32F415XX"

config CPU_MODEL_STM32F417XX
	bool "STM32F417XX"

config CPU_MODEL_STM32F423XX
	bool "STM32F423XX"

config CPU_MODEL_STM32F427XX
	bool "STM32F427XX"

config CPU_MODEL_STM32F429XX
	bool "STM32F429XX"

config CPU_MODEL_STM32F437XX
	bool "STM32F437XX"

config CPU_MODEL_STM32F439XX
	bool "STM32F439XX"

config CPU_MODEL_STM32F446XX
	bool "STM32F446XX"

config CPU_MODEL_STM32F469XX
	bool "STM32F469XX"

config CPU_MODEL_STM32F479XX
	bool "STM32F479XX"

endchoice

source "arch/arm/mach-stm/stm32f4xx/platform.kconf"
```

## arm/mach-stm/stm32f7xx/Kconfig
```kconfig
choice
	prompt "CPU Model"
	depends on CPU_SERIES_STM32F7XX

config CPU_MODEL_STM32F722XX
	bool "STM32F722XX"

config CPU_MODEL_STM32F723XX
	bool "STM32F723XX"

config CPU_MODEL_STM32F730XX
	bool "STM32F730XX"

config CPU_MODEL_STM32F732XX
	bool "STM32F732XX"

config CPU_MODEL_STM32F733XX
	bool "STM32F733XX"

config CPU_MODEL_STM32F745XX
	bool "STM32F745XX"

config CPU_MODEL_STM32F746XX
	bool "STM32F746XX"

config CPU_MODEL_STM32F750XX
	bool "STM32F750XX"

config CPU_MODEL_STM32F756XX
	bool "STM32F756XX"

config CPU_MODEL_STM32F765XX
	bool "STM32F765XX"

config CPU_MODEL_STM32F767XX
	bool "STM32F767XX"

config CPU_MODEL_STM32F769XX
	bool "STM32F769XX"

config CPU_MODEL_STM32F777XX
	bool "STM32F777XX"

config CPU_MODEL_STM32F779XX
	bool "STM32F779XX"

endchoice

choice
	prompt "Platform models"
	depends on CPU_SERIES_STM32F7XX

source "arch/arm/mach-stm/stm32f7xx/kconfig-platform"

endchoice
```

## arm/mach-stm/stm32h5xx/Kconfig
```kconfig
choice
	prompt "CPU Model"
	depends on CPU_SERIES_STM32H5XX

config CPU_MODEL_STM32H503XX
	bool "STM32H503XX"

config CPU_MODEL_STM32H523XX
	bool "STM32H523XX"

config CPU_MODEL_STM32H533XX
	bool "STM32H533XX"

config CPU_MODEL_STM32H562XX
	bool "STM32H562XX"

config CPU_MODEL_STM32H563XX
	bool "STM32H563XX"

config CPU_MODEL_STM32H573XX
	bool "STM32H573XX"

endchoice

choice
	prompt "Platform models"
	depends on CPU_SERIES_STM32H5XX

source "arch/arm/mach-stm/stm32h5xx/kconfig-platform"

endchoice
```

## arm/mach-stm/stm32h7xx/Kconfig
```kconfig
choice
	prompt "CPU Model"
	depends on CPU_SERIES_STM32H7XX

config CPU_MODEL_STM32H723XX
	bool "STM32H723XX"

config CPU_MODEL_STM32H725XX
	bool "STM32H725XX"

config CPU_MODEL_STM32H730XX
	bool "STM32H730XX"

config CPU_MODEL_STM32H730XXQ
	bool "STM32H730XXQ"

config CPU_MODEL_STM32H733XX
	bool "STM32H733XX"

config CPU_MODEL_STM32H735XX
	bool "STM32H735XX"

config CPU_MODEL_STM32H742XX
	bool "STM32H742XX"

config CPU_MODEL_STM32H743XX
	bool "STM32H743XX"

config CPU_MODEL_STM32H745XG
	bool "STM32H745XG"

config CPU_MODEL_STM32H745XX
	bool "STM32H745XX"

config CPU_MODEL_STM32H747XG
	bool "STM32H747XG"

config CPU_MODEL_STM32H747XX
	bool "STM32H747XX"

config CPU_MODEL_STM32H750XX
	bool "STM32H750XX"

config CPU_MODEL_STM32H753XX
	bool "STM32H753XX"

config CPU_MODEL_STM32H755XX
	bool "STM32H755XX"

config CPU_MODEL_STM32H757XX
	bool "STM32H757XX"

config CPU_MODEL_STM32H7A3XX
	bool "STM32H7A3XX"

config CPU_MODEL_STM32H7A3XXQ
	bool "STM32H7A3XXQ"

config CPU_MODEL_STM32H7B0XX
	bool "STM32H7B0XX"

config CPU_MODEL_STM32H7B0XXQ
	bool "STM32H7B0XXQ"

config CPU_MODEL_STM32H7B3XX
	bool "STM32H7B3XX"

config CPU_MODEL_STM32H7B3XXq
	bool "STM32H7B3XXq"

endchoice

choice
	prompt "Platform models"
	depends on CPU_SERIES_STM32H7XX

source "arch/arm/mach-stm/stm32h7xx/kconfig-platform"

endchoice
```
